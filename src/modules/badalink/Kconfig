## src/modules/badalink/Kconfig
```kconfig
menuconfig MODULES_BADALINK
	bool "badalink"
	default n
	---help---
		Enable support for badalink

menuconfig USER_BADALINK
	bool "badalink running as userspace module"
	default n
	depends on BOARD_PROTECTED && MODULES_BADALINK
	---help---
		Put badalink in userspace memory
```

## src/modules/boat_ackermann/Kconfig
```kconfig
menuconfig MODULES_BOAT_ACKERMANN
	bool "boat_ackermann"
	default n
	---help---
		Enable support for ackermann boats
```

## src/modules/fenet/Kconfig
```kconfig
menuconfig MODULES_FENET
	bool "fenet"
	default n
	---help---
		Enable support for fenet
```

## src/modules/plclink/Kconfig
```kconfig
menuconfig MODULES_PLCLINK
	bool "plclink"
	default n
	---help---
		Enable support for PLCLINK
menuconfig USER_PLCLINK
	bool "plclink running as userspace module"
	default y
	depends on BOARD_PROTECTED && MODULES_PLCLINK
	---help---
		Put plclink in userspace memory
```
